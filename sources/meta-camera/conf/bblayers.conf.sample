## sources/meta-camera/conf/bblayers.conf.sample
```bitbake
# POKY_BBLAYERS_CONF_VERSION is increased each time build/conf/bblayers.conf
# changes incompatibly
POKY_BBLAYERS_CONF_VERSION = "2"

BBPATH = "${TOPDIR}"
BBFILES ?= ""

YOCTOROOT = "${@os.path.abspath(os.path.join("${TOPDIR}", os.pardir))}"

BBLAYERS ?= " \
  ${YOCTOROOT}/sources/poky/meta \
  ${YOCTOROOT}/sources/poky/meta-poky \
  ${YOCTOROOT}/sources/poky/meta-yocto-bsp \
  ${YOCTOROOT}/sources/meta-raspberrypi \
  ${YOCTOROOT}/sources/meta-camera \
  ${YOCTOROOT}/sources/meta-openembedded/meta-oe \
  ${YOCTOROOT}/sources/meta-openembedded/meta-python \
  ${YOCTOROOT}/sources/meta-openembedded/meta-networking \
  ${YOCTOROOT}/sources/meta-openembedded/meta-multimedia \
  "
```

## sources/meta-camera/conf/layer.conf
```bitbake
# We have a conf and classes directory, add to BBPATH
BBPATH .= ":${LAYERDIR}"

# We have recipes-* directories, add to BBFILES
BBFILES += "${LAYERDIR}/recipes-*/*/*.bb \
            ${LAYERDIR}/recipes-*/*/*.bbappend"

BBFILE_COLLECTIONS += "meta-camera"
BBFILE_PATTERN_meta-camera = "^${LAYERDIR}/"
BBFILE_PRIORITY_meta-camera = "6"

LAYERDEPENDS_meta-camera = "core"
LAYERSERIES_COMPAT_meta-camera = "scarthgap"
```

## sources/meta-camera/conf/local.conf.sample
```bitbake
# The default is a downloads directory under TOPDIR which is the build directory.
#DL_DIR ?= "${TOPDIR}/downloads"

# The default is a sstate-cache directory under TOPDIR.
#SSTATE_DIR ?= "${TOPDIR}/sstate-cache"

# The default is a tmp directory under TOPDIR.
#TMPDIR = "${TOPDIR}/tmp"

DISTRO ?= "poky"

# PACKAGE_CLASSES ?= "package_rpm"

#SDKMACHINE ?= "i686"

EXTRA_IMAGE_FEATURES ?= "debug-tweaks"

USER_CLASSES ?= "buildstats"

# By default disable interactive patch resolution (tasks will just fail instead):
PATCHRESOLVE = "noop"

BB_DISKMON_DIRS ??= "\
    STOPTASKS,${TMPDIR},1G,100K \
    STOPTASKS,${DL_DIR},1G,100K \
    STOPTASKS,${SSTATE_DIR},1G,100K \
    STOPTASKS,/tmp,100M,100K \
    HALT,${TMPDIR},100M,1K \
    HALT,${DL_DIR},100M,1K \
    HALT,${SSTATE_DIR},100M,1K \
    HALT,/tmp,10M,1K"

# Qemu configuration
#
# By default native qemu will build with a builtin VNC server where graphical output can be
# seen. The line below enables the SDL UI frontend too.
PACKAGECONFIG:append:pn-qemu-system-native = " sdl"
# By default libsdl2-native will be built, if you want to use your host's libSDL instead of 
# the minimal libsdl built by libsdl2-native then uncomment the ASSUME_PROVIDED line below.
#ASSUME_PROVIDED += "libsdl2-native"

# CONF_VERSION is increased each time build/conf/ changes incompatibly and is used to
# track the version of this file when it was generated. This can safely be ignored if
# this doesn't mean anything to you.
CONF_VERSION = "2"

# Machine to build image for
MACHINE = "raspberrypi0-2w-64"

# Default init manager
INIT_MANAGER = "systemd"

# This one is needed to prevent kernel panic at boot time
# Needed for raspberrypi5
# MACHINE = "raspberrypi5"
# RPI_KERNEL_DEVICETREE_OVERLAYS:append = " overlays/bcm2712d0.dtbo"

# Accept synaptics-killswitch license to build WiFi/Bluetooth drivers
LICENSE_FLAGS_ACCEPTED = "synaptics-killswitch"


VIDEO_CAMERA = "1"
RASPBERRYPI_CAMERA_V3 = "1"

hostname:pn-base-files = "babypi"

DISTRO_FEATURES:append = " wifi"

TIMEZONE = "Europe/Warsaw"
WIFI_SSID="YOUR_SSID"
WIFI_PSK="YOUR_PASSWORD"
WPA_COUNTRY="YOUR_COUNTRY"
```
